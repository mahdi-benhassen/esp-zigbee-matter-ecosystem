## end_node/main/Kconfig.projbuild
```kconfig
# Universal End Node Configuration
# Sensor selection, power mode, intervals - all via menuconfig

menu "Universal End Node Configuration"

    comment "===== Sensor Selection (choose one or more) ====="
    comment "Select the sensor(s) connected to this node."
    comment "ZCL clusters are auto-generated from sensor capabilities."

    config SENSOR_STUB
        bool "Stub/Simulation (no hardware)"
        default y if (!SENSOR_SHT30 && !SENSOR_SHT4X && !SENSOR_AHT20 && !SENSOR_DHT22 && !SENSOR_INTERNAL && !SENSOR_BME280 && !SENSOR_BH1750 && !SENSOR_VEML7700 && !SENSOR_SCD41 && !SENSOR_DS18B20 && !SENSOR_ZE03_NH3 && !SENSOR_SOIL_MOISTURE && !SENSOR_JSN_SR04T && !SENSOR_HX711)
        default n
        help
            Generate simulated sensor data. No hardware required.
            Useful for development and testing. Provides temperature
            and humidity simulation via random walk algorithm.

    config SENSOR_INTERNAL
        bool "ESP32 Internal Temperature Sensor"
        default n
        help
            Use the ESP32 on-die temperature sensor.
            Provides temperature only (no humidity).
            Note: Reads die temperature, not ambient.

    config SENSOR_SHT30
        bool "Sensirion SHT30 (I2C)"
        default n
        help
            High-accuracy temperature/humidity sensor.
            +/- 0.2C, +/- 2% RH. I2C address 0x44.

    config SENSOR_SHT4X
        bool "Sensirion SHT40/SHT41 (I2C)"
        default n
        help
            Ultra-high accuracy temperature/humidity sensor.
            +/- 0.1C (SHT41), +/- 1.8% RH. I2C address 0x44.
            Recommended for production use.

    config SENSOR_AHT20
        bool "Aosong AHT20 (I2C)"
        default n
        help
            Budget temperature/humidity sensor.
            +/- 0.3C, +/- 2% RH. I2C address 0x38.
            Good value for cost-sensitive applications.

    config SENSOR_DHT22
        bool "DHT22/AM2302 (One-Wire)"
        default n
        help
            Basic temperature/humidity sensor.
            +/- 0.5C, +/- 2-5% RH. Single GPIO.
            Slower reads (~2s between measurements).

    config SENSOR_BME280
        bool "Bosch BME280 (I2C)"
        default n
        help
            Bosch BME280 temperature/humidity/pressure sensor.
            +/- 1.0C, +/- 3% RH, +/- 1 hPa. I2C address 0x76/0x77.

    config SENSOR_BH1750
        bool "ROHM BH1750 (I2C)"
        default n
        help
            ROHM BH1750FVI digital light/illuminance sensor.
            1 - 65535 lux. I2C address 0x23.

    config SENSOR_VEML7700
        bool "Vishay VEML7700 (I2C)"
        default n
        help
            Vishay VEML7700 digital light/illuminance sensor.
            High resolution, 0 - 120 klux. I2C address 0x10.

    config SENSOR_SCD41
        bool "Sensirion SCD41 (I2C)"
        default n
        help
            Sensirion SCD41 photoacoustic CO2 sensor.
            400 - 5000 ppm. I2C address 0x62.

    config SENSOR_DS18B20
        bool "Maxim DS18B20 (1-Wire)"
        default n
        help
            Maxim DS18B20 digital soil temperature sensor.
            +/- 0.5C. Single GPIO bit-bang.

    config SENSOR_ZE03_NH3
        bool "Winsen ZE03-NH3 (UART)"
        default n
        help
            Winsen ZE03 electrochemical ammonia (NH3) sensor.
            0 - 100 ppm. UART interface.

    config SENSOR_SOIL_MOISTURE
        bool "Capacitive Soil Moisture (Analog)"
        default n
        help
            Analog capacitive soil moisture sensor.
            Requires ADC1 channel.

    config SENSOR_JSN_SR04T
        bool "JSN-SR04T Ultrasonic Distance (GPIO)"
        default n
        help
            JSN-SR04T waterproof ultrasonic distance/depth sensor.
            20 - 600 cm. Trigger/Echo GPIOs.

    config SENSOR_HX711
        bool "HX711 Load Cell Weight (GPIO)"
        default n
        help
            HX711 load cell amplifier for weight measurement.
            2-wire GPIO serial interface.

    comment "===== I2C Configuration (for I2C sensors) ====="

    config SENSOR_I2C_SDA_PIN
        int "I2C SDA GPIO Pin"
        depends on SENSOR_SHT30 || SENSOR_SHT4X || SENSOR_AHT20 || SENSOR_BME280 || SENSOR_BH1750 || SENSOR_VEML7700 || SENSOR_SCD41
        default 6
        range 0 31
        help
            GPIO pin for I2C SDA (data) line.
            Common: GPIO6, GPIO4, GPIO0

    config SENSOR_I2C_SCL_PIN
        int "I2C SCL GPIO Pin"
        depends on SENSOR_SHT30 || SENSOR_SHT4X || SENSOR_AHT20 || SENSOR_BME280 || SENSOR_BH1750 || SENSOR_VEML7700 || SENSOR_SCD41
        default 7
        range 0 31
        help
            GPIO pin for I2C SCL (clock) line.
            Common: GPIO7, GPIO5, GPIO1

    config SENSOR_I2C_FREQ_HZ
        int "I2C Clock Frequency"
        depends on SENSOR_SHT30 || SENSOR_SHT4X || SENSOR_AHT20 || SENSOR_BME280 || SENSOR_BH1750 || SENSOR_VEML7700 || SENSOR_SCD41
        default 100000
        range 50000 400000
        help
            I2C bus frequency in Hz.
            100KHz = standard mode, 400KHz = fast mode.

    comment "===== DHT22 Configuration ====="

    config SENSOR_DHT_PIN
        int "DHT22 Data GPIO Pin"
        depends on SENSOR_DHT22
        default 5
        range 0 31
        help
            GPIO pin connected to DHT22 data line.
            Requires 10K pull-up resistor to 3.3V.

    comment "===== DS18B20 Configuration ====="

    config SENSOR_DS18B20_PIN
        int "DS18B20 1-Wire GPIO Pin"
        depends on SENSOR_DS18B20
        default 5
        range 0 31
        help
            GPIO pin connected to DS18B20 1-Wire line.

    comment "===== ZE03 NH3 Configuration ====="

    config SENSOR_ZE03_UART_PORT
        int "ZE03 UART Port Number (0-2)"
        depends on SENSOR_ZE03_NH3
        default 1
        range 0 2
        help
            UART port used to communicate with ZE03 sensor.

    config SENSOR_ZE03_TX_PIN
        int "ZE03 UART TX GPIO Pin"
        depends on SENSOR_ZE03_NH3
        default 24
        range 0 31
        help
            GPIO pin connected to ZE03 RXD pin.

    config SENSOR_ZE03_RX_PIN
        int "ZE03 UART RX GPIO Pin"
        depends on SENSOR_ZE03_NH3
        default 23
        range 0 31
        help
            GPIO pin connected to ZE03 TXD pin.

    comment "===== Soil Moisture Configuration ====="

    config SENSOR_SOIL_ADC_CHANNEL
        int "Soil Moisture ADC1 Channel"
        depends on SENSOR_SOIL_MOISTURE
        default 1
        range 0 4
        help
            ADC1 channel for soil moisture analog voltage.
            GPIO2 is ADC1 Channel 1 on ESP32-H2.

    comment "===== JSN-SR04T Configuration ====="

    config SENSOR_JSN_TRIG_PIN
        int "JSN Trig GPIO Pin"
        depends on SENSOR_JSN_SR04T
        default 0
        range 0 31
        help
            GPIO pin connected to JSN-SR04T Trigger pin.

    config SENSOR_JSN_ECHO_PIN
        int "JSN Echo GPIO Pin"
        depends on SENSOR_JSN_SR04T
        default 1
        range 0 31
        help
            GPIO pin connected to JSN-SR04T Echo pin.

    comment "===== HX711 Configuration ====="

    config SENSOR_HX711_SCK_PIN
        int "HX711 SCK GPIO Pin"
        depends on SENSOR_HX711
        default 10
        range 0 31
        help
            GPIO pin connected to HX711 clock pin.

    config SENSOR_HX711_DOUT_PIN
        int "HX711 DOUT GPIO Pin"
        depends on SENSOR_HX711
        default 11
        range 0 31
        help
            GPIO pin connected to HX711 data pin.

    comment "===== Timing Configuration ====="

    config SENSOR_READ_INTERVAL_SEC
        int "Sensor Read Interval (seconds)"
        default 30
        range 5 3600
        help
            How often to read sensor values.
            Shorter = more responsive but more power.
            Longer = more power saving.

    config SENSOR_REPORT_INTERVAL_SEC
        int "ZCL Report Interval (seconds)"
        default 60
        range 10 3600
        help
            How often to send ZCL attribute reports
            to the coordinator.

    comment "===== Power Mode ====="

    choice POWER_MODE
        prompt "Power Mode"
        default POWER_SLEEPY
        help
            Sleepy End Device: ultra-low power, deep sleep
            between reads. Best for battery operation.
            Always On: stays awake. Only for mains-powered.

        config POWER_SLEEPY
            bool "Sleepy End Device (SED) - Battery"

        config POWER_ALWAYS_ON
            bool "Always On - Mains Powered"
    endchoice

    config SLEEP_DURATION_SEC
        int "Deep Sleep Duration (seconds)"
        depends on POWER_SLEEPY
        default 30
        range 5 1800
        help
            Duration of deep sleep between wake cycles.
            Device wakes, reads sensors, reports, sleeps.

    comment "===== Battery Monitoring ====="

    config BATTERY_VOLTAGE_MIN
        int "Battery Minimum Voltage (mV)"
        default 2000
        range 1500 3000
        help
        Low battery warning threshold.

    config BATTERY_VOLTAGE_MAX
        int "Battery Maximum Voltage (mV)"
        default 3000
        range 2000 4200
        help
        Fully charged battery voltage.

    config END_NODE_LOG_LEVEL
        int "Log Verbosity"
        default 3
        range 0 5
        help
            0=NONE, 1=ERROR, 2=WARN, 3=INFO, 4=DEBUG, 5=VERBOSE

endmenu
```

## end_node/sdkconfig.defaults
```kconfig
# Universal End Node - ESP32-H2 / ESP32-C6
# One firmware for ALL sensor types (select via menuconfig)

CONFIG_IDF_TARGET="esp32h2"

# Partition Table (4MB flash)
CONFIG_PARTITION_TABLE_CUSTOM=y
CONFIG_PARTITION_TABLE_CUSTOM_FILENAME="partitions.csv"
CONFIG_PARTITION_TABLE_OFFSET=0x8000

CONFIG_ESPTOOLPY_FLASHSIZE_4MB=y
CONFIG_ESPTOOLPY_FLASHSIZE="4MB"

# Zigbee as End Device (Sleepy)
CONFIG_ZB_ENABLED=y
CONFIG_ZB_RADIO_NATIVE=y
CONFIG_ZB_ZED=y
CONFIG_ZB_ED_ROLE=y

# IEEE 802.15.4 Radio
CONFIG_IEEE802154_ENABLED=y
CONFIG_IEEE802154_RX_BUFFER_NUM=4

# Power management for Sleepy End Device
CONFIG_PM_ENABLE=y
CONFIG_ESP_SLEEP_POWER_DOWN_FLASH=y
CONFIG_FREERTOS_USE_TICKLESS_IDLE=y
CONFIG_FREERTOS_IDLE_TIME_BEFORE_SLEEP=3

# CPU at 48MHz for power saving
CONFIG_ESP_DEFAULT_CPU_FREQ_MHZ_48=y

# Stack sizes
CONFIG_ESP_MAIN_TASK_STACK_SIZE=8192
CONFIG_ESP_SYSTEM_EVENT_TASK_STACK_SIZE=2048

# FreeRTOS
CONFIG_FREERTOS_HZ=1000
CONFIG_FREERTOS_UNICORE=y

# Logging
CONFIG_LOG_DEFAULT_LEVEL_INFO=y
CONFIG_LOG_MAXIMUM_LEVEL_DEBUG=y

# Disable unused features to save memory
CONFIG_ESP_WIFI_ENABLED=n
CONFIG_BT_ENABLED=n
CONFIG_ESP_HTTP_CLIENT_ENABLE=n
CONFIG_ESP_HTTPS_SERVER_ENABLE=n

# I2C master driver
CONFIG_I2C_ENABLE_SLAVE_DRIVER=n

# GPIO
CONFIG_GPIO_RANGE_MAX=31

# NVS
CONFIG_NVS_ENCRYPTION=n

CONFIG_ZB_SDK_1xx=y
```

## gateway/main_soc/main/Kconfig.projbuild
```kconfig
# Gateway Configuration - Dual-SoC ESP32-S3 + ESP32-H2

menu "Gateway Configuration (Dual-SoC)"

    comment "===== Wi-Fi Configuration ====="

    config WIFI_SSID
        string "Wi-Fi SSID"
        default "your-ssid"
        help
            Wi-Fi network name (SSID) for the gateway to connect to.

    config WIFI_PASSWORD
        string "Wi-Fi Password"
        default "your-password"
        help
            Wi-Fi password (WPA2 or WPA3).

    comment "===== ESP32-H2 RCP (Radio Co-Processor) ====="
    comment "UART wiring: S3 TX -> H2 RX, S3 RX <- H2 TX"

    config ZB_UART_PORT
        int "RCP UART Port"
        default 1
        range 1 2
        help
            UART port number for ESP32-H2 RCP communication.
            UART1 or UART2. UART0 is reserved for debug console.

    config ZB_UART_TX_PIN
        int "RCP UART TX Pin (S3 -> H2)"
        default 5
        range 0 48
        help
            ESP32-S3 GPIO pin for UART TX to ESP32-H2.
            Recommended: GPIO5 (UART1 default TX).

    config ZB_UART_RX_PIN
        int "RCP UART RX Pin (S3 <- H2)"
        default 4
        range 0 48
        help
            ESP32-S3 GPIO pin for UART RX from ESP32-H2.
            Recommended: GPIO4 (UART1 default RX).

    config ZB_UART_BAUDRATE
        int "RCP UART Baud Rate"
        default 115200
        range 9600 921600
        help
            UART baud rate for RCP communication.
            Must match ESP32-H2 RCP firmware baud rate.
            Default 115200. Try 460800 for higher throughput.

    comment "===== Zigbee Network Configuration ====="

    config ZB_CHANNEL
        int "Zigbee Channel"
        default 13
        range 11 26
        help
            Zigbee radio channel (11-26).
            Channel 13 avoids common Wi-Fi interference.

    config ZB_PANID
        hex "Zigbee PAN ID"
        default 0x1A62
        range 0x0000 0xFFFF
        help
            Personal Area Network ID. Unique per network.

    config ZB_EXTPANID
        string "Zigbee Extended PAN ID"
        default "ESP_ZB_GW01"
        help
            Extended PAN identifier (8 bytes ASCII).

    config ZB_MAX_CHILDREN
        int "Maximum Child Nodes"
        default 32
        range 1 64
        help
            Maximum number of end devices that can join.

    comment "===== Web Server (Stage 2) ====="

    config GATEWAY_WEB_SERVER_PORT
        int "HTTP Server Port"
        default 80
        range 1 65535
        help
            TCP port for the management web server.

    comment "===== Diagnostics ====="

    config GATEWAY_LOG_LEVEL
        int "Log Verbosity"
        default 3
        range 0 5
        help
            0=NONE, 1=ERROR, 2=WARN, 3=INFO, 4=DEBUG, 5=VERBOSE

endmenu
```
