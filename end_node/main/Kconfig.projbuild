## gateway/sdkconfig.defaults
```kconfig
# Gateway Default Configuration - ESP32-S3 + ESP32-H2 Dual-SoC
# Host: ESP32-S3 (Wi-Fi + Application)
# Radio Co-Processor: ESP32-H2 via UART (ot_rcp / ZBOSS RCP)

# Target: ESP32-S3 (Wi-Fi Host)
CONFIG_IDF_TARGET="esp32s3"

# Partition Table (8MB flash on ESP32-S3)
CONFIG_PARTITION_TABLE_CUSTOM=y
CONFIG_PARTITION_TABLE_CUSTOM_FILENAME="partitions.csv"
CONFIG_PARTITION_TABLE_OFFSET=0x8000

CONFIG_ESPTOOLPY_FLASHSIZE_8MB=y
CONFIG_ESPTOOLPY_FLASHSIZE="8MB"

# Wi-Fi Configuration (ESP32-S3 native)
CONFIG_ESP_WIFI_STATIC_RX_BUFFER_NUM=8
CONFIG_ESP_WIFI_DYNAMIC_RX_BUFFER_NUM=16
CONFIG_ESP_WIFI_DYNAMIC_TX_BUFFER_NUM=16
CONFIG_ESP_WIFI_TX_BA_WIN=6
CONFIG_ESP_WIFI_RX_BA_WIN=6
CONFIG_ESP_WIFI_TASK_PINNED_TO_CORE_0=y

# Wi-Fi AMPDU
CONFIG_ESP_WIFI_AMPDU_TX_ENABLED=y
CONFIG_ESP_WIFI_AMPDU_RX_ENABLED=y

# Zigbee via UART RCP (ESP32-H2)
CONFIG_ZB_ENABLED=y
CONFIG_ZB_RADIO_RCP=y
CONFIG_ZB_UART_RX_PIN=4
CONFIG_ZB_UART_TX_PIN=5
CONFIG_ZB_UART_BAUDRATE=115200
CONFIG_ZB_UART_PORT=1
CONFIG_ZB_ZCZR=y
CONFIG_ZB_MAX_CHILDREN=32
CONFIG_ZB_CHANNEL=13
CONFIG_ZB_PANID=0x1A62
CONFIG_ZB_EXTPANID="ESP_ZB_GW01"

# IEEE 802.15.4 via RCP
CONFIG_IEEE802154_ENABLED=y
CONFIG_IEEE802154_UART_RX_PIN=4
CONFIG_IEEE802154_UART_TX_PIN=5
CONFIG_IEEE802154_UART_BAUDRATE=115200
CONFIG_IEEE802154_UART_PORT=1

# ESP32-H2 RCP firmware path (for combined flashing)
CONFIG_ESP32H2_RCP_FIRMWARE_PATH=""

# Matter SDK (Stage 2)
CONFIG_ENABLE_ESP32_BLE_CONTROLLER=n
CONFIG_ENABLE_CHIPTOOL=n
CONFIG_ENABLE_EXTERNAL_COMMISSIONING=n

# LWIP Configuration
CONFIG_LWIP_MAX_SOCKETS=16
CONFIG_LWIP_SO_RCVRCVTIMEO_NONSTANDARD=y
CONFIG_LWIP_HOOK_IP6_ROUTE_CUSTOM=n
CONFIG_LWIP_HOOK_ND6_GET_GW_CUSTOM=n

# HTTP Server (Stage 2)
CONFIG_HTTPD_MAX_REQ_HDR_LEN=1024
CONFIG_HTTPD_MAX_URI_LEN=512
CONFIG_HTTPD_ERR_RESP_NO_DELAY=y
CONFIG_HTTPD_PURGE_BUF_LEN=64

# Event Loop
CONFIG_ESP_SYSTEM_EVENT_TASK_STACK_SIZE=4096

# Main task (ESP32-S3 has more RAM)
CONFIG_ESP_MAIN_TASK_STACK_SIZE=12288
CONFIG_ESP_MAIN_TASK_AFFINITY_CPU1=y

# FreeRTOS (dual core ESP32-S3)
CONFIG_FREERTOS_UNICORE=n
CONFIG_FREERTOS_HZ=1000

# Logging
CONFIG_LOG_DEFAULT_LEVEL_INFO=y
CONFIG_LOG_MAXIMUM_LEVEL_DEBUG=y

# SPIFFS for web dashboard files
CONFIG_SPIFFS_MAX_PARTITIONS=2
CONFIG_SPIFFS_PAGE_SIZE=256
CONFIG_SPIFFS_OBJ_NAME_LEN=64
CONFIG_SPIFFS_USE_MAGIC=y
CONFIG_SPIFFS_USE_MAGIC_LENGTH=y
CONFIG_SPIFFS_META_LENGTH=4

# FATFS for OTA storage
CONFIG_FATFS_LFN_HEAP=y
CONFIG_FATFS_MAX_LFN=255

# CPU Frequency - ESP32-S3 at 240MHz
CONFIG_ESP_DEFAULT_CPU_FREQ_MHZ_240=y

# GPIO / LEDC
CONFIG_LEDC_LOW_SPEED_MODE=y

# USB-OTG (for debug console on some boards)
CONFIG_USB_OTG_SUPPORTED=y
CONFIG_ZB_SDK_1xx=y
```
